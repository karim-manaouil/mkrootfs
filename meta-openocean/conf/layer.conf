## meta-openocean/conf/layer.conf
```bitbake
# We have a conf and classes directory, add to BBPATH
BBPATH .= ":${LAYERDIR}"

# We have recipes-* directories, add to BBFILES
BBFILES += "${LAYERDIR}/recipes-*/*/*.bb \
            ${LAYERDIR}/recipes-*/*/*.bbappend"

BBFILE_COLLECTIONS += "meta-openocean"
BBFILE_PATTERN_meta-openocean = "^${LAYERDIR}/"
BBFILE_PRIORITY_meta-openocean = "6"

LAYERDEPENDS_meta-openocean = "core"
LAYERSERIES_COMPAT_meta-openocean = "thud"
```
